// SPDX-License-Identifier: GPL-2.0-only
/*
 * Husky board device tree source
 *
 * Copyright 2022 Google LLC
 */

/dts-v1/;
/plugin/;

#include "zuma-husky-common.dtsi"
#include "zuma-shusky-wcharger.dtsi"

/ {
	board_id = <0x40204>;
	board_rev = <0x010000>;
	fragment@boardbase {
		target-path = "/";
		__overlay__ {
			model = "ZUMA HUSKY DVT 1.0 based on ZUMA";
			compatible = "google,ZUMA HUSKY", "google,ZUMA";
		};
	};
};
