// SPDX-License-Identifier: GPL-2.0-only
/*
 * SideBand Bit Multiplexer device tree source
 *
 * Copyright 2022 Google LLC
 *
 * This program is free software; you can redistribute it and/or modify
 * it under the terms of the GNU General Public License version 2 as
 * published by the Free Software Foundation.
 */

#include <dt-bindings/pinctrl/samsung.h>
#include <dt-bindings/gpio/gpio.h>

/ {
	fragment@sbbmux {
		target-path = "/";
		__overlay__ {
			sbb_mux: sbb-mux {
				compatible = "google,sbb-mux";
				gpios = <&gpp10 2 0>, <&gpp16 3 0>, <&gpp0 0 0>, <&gpp19 2 0>;
				gpio_names = "C1_T0__XAPC_USI5_RTSN_DI",
						"C1_T1__XAPC_USI14_CTSN_CSN",
						"C1_T2__XAPC_GPIO0",
						"C1_T3__XAPC_USI0_RTSN_DI";
				default_signals = "gp_region_0", "gp_region_1",
							"gp_region_2", "gp_region_3";
			};
		};
	};
};
