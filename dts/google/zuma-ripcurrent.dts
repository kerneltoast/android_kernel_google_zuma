// SPDX-License-Identifier: GPL-2.0-only
/*
 * Ripcurrent board device tree source
 *
 * Copyright 2022 Google LLC
 */

/dts-v1/;
/plugin/;

#include <dt-bindings/interrupt-controller/arm-gic.h>
#include <dt-bindings/pinctrl/zuma.h>
#include <dt-bindings/pinctrl/samsung.h>

#include "../google-dts-base/zuma-common.dtsi"

#include "zuma-ripcurrent-battery.dtsi"
#include "zuma-ripcurrent-camera-pmic.dtsi"
#include "zuma-ripcurrent-camera.dtsi"
#include "zuma-ripcurrent-charging.dtsi"
#include "zuma-ripcurrent-display.dtsi"
#include "zuma-ripcurrent-gsa-gsc.dtsi"
#include "zuma-ripcurrent-pmic.dtsi"
#include "zuma-ripcurrent-touch.dtsi"
#include "zuma-ripcurrent-usb.dtsi"
#include "zuma-ripcurrent-usecases.dtsi"
#include "zuma-ripcurrent-wcharger.dtsi"
#include "../google-dts-base/zuma-board-wlan.dtsi"
#include "../google-dts-base/zuma-board-cp-s5300-sit.dtsi"
#include "../google-dts-base/zuma-board-bluetooth.dtsi"
#include "../google-dts-base/zuma-board-ese.dtsi"
#include "../google-dts-base/zuma-board-nfc.dtsi"
#include "../google-dts-base/zuma-board-gps.dtsi"
#include "../google-dts-base/zuma-board-udfps.dtsi"
#include "zuma-ripcurrent-audio.dtsi"
#include "../google-dts-base/zuma-board-pcie.dtsi"
#include "zuma-ripcurrent-haptics.dtsi"
#include "../google-dts-base/zuma-board-uwb.dtsi"
#include "zuma-ripcurrent-thermal.dtsi"
#include "zuma-ripcurrent-sbbm.dtsi"
#include "zuma-ripcurrent-bcl.dtsi"
#include "zuma-ripcurrent-bluetooth.dtsi"
#include "zuma-ripcurrent-bluetooth-offmode.dtsi"
#include "zuma-ripcurrent-typec.dtsi"
#include "../google-dts-base/gs101-cp-s5200-thermal-zone.dtsi"

/ {
	board_id = <0x40101>;
	board_rev = <0x000000>;
	fragment@boardbase {
		target-path = "/";
		__overlay__ {
			model = "ZUMA Ripcurrent board based on ZUMA";
			compatible = "google,ZUMA Ripcurrent", "google,ZUMA";
		};
	};
};

