// SPDX-License-Identifier: GPL-2.0-only
/*
 * husky audio device tree source
 *
 * Copyright 2022 Google LLC
 */

#include "zuma-shusky-audio.dtsi"

&aoc {
	aoc-board-cfg = "HK3";
	aoc-board-id = <0x40202>;
	aoc-board-rev = <0x10000>;
	prevent-fw-load = <0x0>;
};

