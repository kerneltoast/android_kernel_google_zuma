// SPDX-License-Identifier: GPL-2.0-only
/*
 * Charge Pump config for ln8411.
 * Intended to be included into the approriate I2C bus.
 *
 * Copyright 2023 Google LLC
 */

ln8411_dc: ln8411@6e {
	status = "disabled";
	compatible = "ln8411";
	reg = <0x6e>;

	ln8411,psy_name = "dc-mains";

	ln8411,input-itopoff = <500000>; /* 500mA */

	/* USBC thermal zone */
	google,usb-port-tz-name = "usbc-therm-adc";

	ln8411,google_cpm = <&google_cpm>;
	ln8411,input-current-limit = <3000000>;

	ln8411_gpio: ln8411_gpio {
		gpio-controller;
		#gpio-cells = <2>;
		ngpios = <1>;
	};
};
