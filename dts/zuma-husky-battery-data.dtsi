// SPDX-License-Identifier: GPL-2.0-only
/*
 * Battery device tree entries
 *
 * Copyright 2022 Google LLC
 *
 */

maxim,config {

	/* R4_p1_gen.ini, 2021-01-21, b/174787673, generic model */
	maxim,default-a1-0k {
		maxim,batt-id-kohm = <0>;
		maxim,model-version = <0>;
		maxim,fg-model = /bits/ 16 <
			0x9760 0xa510 0xb100 0xb600 0xb7a0 0xb900 0xba70 0xbc70
			0xbde0 0xbfc0 0xc250 0xc510 0xc990 0xcea0 0xd040 0xd750
			0x0060 0x0120 0x0200 0x0710 0x0e80 0x0df0 0x1430 0x1bd0
			0x1520 0x0d70 0x0950 0x08e0 0x0800 0x0780 0x06b0 0x01e0
			0x0100 0x0100 0x0100 0x0100 0x0100 0x0100 0x0100 0x0100
			0x0100 0x0100 0x0100 0x0100 0x0100 0x0100 0x0100 0x0100
		>;
		maxim,fg-params = /bits/ 16 <
			/* 0x0036 */	0xf060	/* IAvgEmpty */
			/* 0x002a */	0x2038	/* RelaxCFG */
			/* 0x0028 */	0x260E	/* LearnCFG */
			/* 0x001D */	0x4217	/* Config */
			/* 0x00BB */	0x0090	/* Config2 */
			/* 0x0013 */	0x5F00	/* FullSOCthr */
			/* 0x0035 */	0x0994	/* FullCAPRep */
			/* 0x0018 */	0x0994	/* DesignCap */
			/* 0x0046 */	0x0c80	/* dPacc */
			/* 0x0045 */	0x0099	/* dQacc */
			/* 0x0023 */	0x0994	/* FullCAPNom */
			/* 0x003A */	0xA561	/* V_empty */
			/* 0x0012 */	0x1100	/* QResidual00 */
			/* 0x0022 */	0x0800	/* QResidual10 */
			/* 0x0032 */	0x0301	/* QResidual20 */
			/* 0x0042 */	0x0302	/* QResidual30 */
			/* 0x0038 */	0x0700	/* RCOMP0 */
			/* 0x0039 */	0x223E	/* TempCo */
			/* 0x001E */	0x0310	/* ICHGTerm */
			/* 0x002C */	0xED51	/* TGain */
			/* 0x002D */	0x1EBA	/* TOff */
			/* 0x00B9 */	0x0014	/* Curve */
			/* 0x002B */	0x3870	/* MiscCFG */
			/* 0x0004 */	0x0000	/* AtRate */
			/* 0x0049 */	0x2241	/* convgcfg */
			/* 0x0029 */	0xc623	/* FilterCFG */
			/* 0x003c */	0x2D00	/* TaskPeriod */
		>;
	};

	/* HK3_ATL(3340)_RC2_Rev5.txt b/335076546#comment1 */
	maxim,atl-a1-1k {
		maxim,batt-id-kohm = <1>;
		maxim,model-version = <5>;
		maxim,force-reset-model-data;
		maxim,rc1-tempco = /bits/ 16 <0x0e1f>;
		maxim,fg-model = /bits/ 16 <
                        0xa500 0xb790 0xb920 0xba60 0xbc70 0xbe00 0xbea0 0xc0b0
                        0xc270 0xc5d0 0xc930 0xcc40 0xcf40 0xd340 0xd6b0 0xde40
                        0x01e0 0x0b00 0x0d00 0x1310 0x1710 0x1410 0x0f00 0x0b00
                        0x0910 0x0810 0x07b0 0x07e0 0x05b0 0x07f0 0x04f0 0x04f0
                        0x0200 0x0200 0x0200 0x0200 0x0200 0x0200 0x0200 0x0200
                        0x0200 0x0200 0x0200 0x0200 0x0200 0x0200 0x0200 0x0200
		>;
		maxim,fg-params = /bits/ 16 <
			/* 0x0036 */	0xf060	/* IAvgEmpty */
			/* 0x002a */	0x1439	/* RelaxCFG */
			/* 0x0028 */	0x260e	/* LearnCFG */
			/* 0x001D */	0x4217	/* Config */
			/* 0x00BB */	0x0090	/* Config2 */
			/* 0x0013 */	0x5f00	/* FullSOCthr */
			/* 0x0035 */	0x09cf	/* FullCAPRep */
			/* 0x0018 */	0x09cf	/* DesignCap */
			/* 0x0046 */	0x3200	/* dPacc */
			/* 0x0045 */	0x0273	/* dQacc */
			/* 0x0023 */	0x09cf	/* FullCAPNom */
			/* 0x003A */	0xa561	/* V_empty */
			/* 0x0012 */	0x2400	/* QResidual00 */
			/* 0x0022 */	0x0f80	/* QResidual10 */
			/* 0x0032 */	0x0580	/* QResidual20 */
			/* 0x0042 */	0x0480	/* QResidual30 */
			/* 0x0038 */	0x03b0	/* RCOMP0 */
			/* 0x0039 */	0x1402	/* TempCo */
			/* 0x001E */	0x0630	/* ICHGTerm */
			/* 0x002C */	0xED51	/* TGain */
			/* 0x002D */	0x1EBA	/* TOff */
			/* 0x00B9 */	0x0014	/* Curve */
			/* 0x002B */	0x6070	/* MiscCFG */
			/* 0x0004 */	0x1900	/* AtRate */
			/* 0x0049 */	0x2241	/* convgcfg */
			/* 0x0029 */	0x0613	/* FilterCFG */
			/* 0x003c */	0x2D00	/* TaskPeriod */
		>;
	};

	/* HK3_COS(3341)_RC2_Rev5.txt b/335076546#comment1 */
	maxim,cos-a1-2k {
		maxim,batt-id-kohm = <2>;
		maxim,model-version = <5>;
		maxim,force-reset-model-data;
		maxim,rc1-tempco = /bits/ 16 <0x0f1f>;
		maxim,fg-model = /bits/ 16 <
                        0xa500 0xb790 0xb820 0xb8a0 0xba90 0xbc00 0xbd80 0xbee0
                        0xc050 0xc1e0 0xc3e0 0xc6d0 0xca10 0xd080 0xd6f0 0xdd80
                        0x0180 0x1410 0x1600 0x0e00 0x0f20 0x0f30 0x1200 0x1130
                        0x0f60 0x0bc0 0x07f0 0x06e0 0x0650 0x0790 0x06d0 0x06d0
                        0x0200 0x0200 0x0200 0x0200 0x0200 0x0200 0x0200 0x0200
                        0x0200 0x0200 0x0200 0x0200 0x0200 0x0200 0x0200 0x0200
		>;
		maxim,fg-params = /bits/ 16 <
			/* 0x0036 */	0xf060	/* IAvgEmpty */
			/* 0x002a */	0x1439	/* RelaxCFG */
			/* 0x0028 */	0x260e	/* LearnCFG */
			/* 0x001D */	0x4217	/* Config */
			/* 0x00BB */	0x0090	/* Config2 */
			/* 0x0013 */	0x5f00	/* FullSOCthr */
			/* 0x0035 */	0x09c4	/* FullCAPRep */
			/* 0x0018 */	0x09c4	/* DesignCap */
			/* 0x0046 */	0x3200	/* dPacc */
			/* 0x0045 */	0x0271	/* dQacc */
			/* 0x0023 */	0x09c4	/* FullCAPNom */
			/* 0x003A */	0xa561	/* V_empty */
			/* 0x0012 */	0x2000	/* QResidual00 */
			/* 0x0022 */	0x0e80	/* QResidual10 */
			/* 0x0032 */	0x0580	/* QResidual20 */
			/* 0x0042 */	0x0480	/* QResidual30 */
			/* 0x0038 */	0x03b0	/* RCOMP0 */
			/* 0x0039 */	0x1602	/* TempCo */
			/* 0x001E */	0x0630	/* ICHGTerm */
			/* 0x002C */	0xED51	/* TGain */
			/* 0x002D */	0x1EBA	/* TOff */
			/* 0x00B9 */	0x0014	/* Curve */
			/* 0x002B */	0x6070	/* MiscCFG */
			/* 0x0004 */	0x1900	/* AtRate */
			/* 0x0049 */	0x2241	/* convgcfg */
			/* 0x0029 */	0x0613	/* FilterCFG */
			/* 0x003c */	0x2D00	/* TaskPeriod */
		>;
	};
};
