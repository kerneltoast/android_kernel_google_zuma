// SPDX-License-Identifier: GPL-2.0-only
/*
 * Shiba board device tree source
 *
 * Copyright 2022 Google LLC
 */

/dts-v1/;
/plugin/;

#include "zuma-shiba-common.dtsi"
#include "zuma-shusky-wcharger-proto.dtsi"

/ {
	board_id = <0x40302>;
	board_rev = <0x010100>;
	fragment@boardbase {
		target-path = "/";
		__overlay__ {
			model = "ZUMA SHIBA Proto 1.1 board based on ZUMA";
			compatible = "google,ZUMA SHIBA", "google,ZUMA";
		};
	};
};
