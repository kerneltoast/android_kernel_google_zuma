// SPDX-License-Identifier: GPL-2.0-only
/*
 * Husky board device tree source
 *
 * Copyright 2022 Google LLC
 */

/dts-v1/;
/plugin/;

#include "zuma-husky-common.dtsi"
#include "zuma/zuma-ripcurrent-bluetooth-offmode.dtsi"
#include "zuma-shusky-wcharger-proto.dtsi"

/ {
	board_id = <0x40202>;
	board_rev = <0x010001>;
	fragment@boardbase {
		target-path = "/";
		__overlay__ {
			model = "ZUMA HUSKY Proto 1.0 Wingboard based on ZUMA";
			compatible = "google,ZUMA HUSKY", "google,ZUMA";
		};
	};
};
