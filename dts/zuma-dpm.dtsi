// SPDX-License-Identifier: GPL-2.0-only
/*
 * Zuma Debug Policy Manager device tree source
 *
 * Copyright 2022 Google Inc.
 */

/ {
	#address-cells = <2>;
	#size-cells = <1>;
	dpm: dpm  {
	}; /* end of dpm */
}; /* end of root */

/* default settings built into kernel dt */
#include "zuma-dpm-user.dtsi"
