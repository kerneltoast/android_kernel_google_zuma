// SPDX-License-Identifier: GPL-2.0-only
/*
 * Zuma on emulator device tree source
 *
 * Copyright 2020-2021 Google LLC
 */

/dts-v1/;
/plugin/;

#include "zuma-emul-display.dtsi"

/ {
	board_id = <0x48000>;
	board_rev = <0x1>;
	fragment@boardbase {
		target-path="/";
		__overlay__ {
			model = "ZUMA Emulator based";
			compatible = "google,ZUMA Emulator", "google,ZUMA";
			fixed-rate-clocks {
				console_clock: console-clock {
					compatible = "fixed-clock";
					#clock-cells = <0>;
					clock-frequency = <1843200>;
					clock-output-names = "console-clock";
				};
			};
		};
	};
};

&serial_0 {
	status = "okay";
	clocks = <&console_clock>, <&console_clock>;
	samsung,source-clock-rate = <1843200>;
};
