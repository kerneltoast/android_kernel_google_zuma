// SPDX-License-Identifier: GPL-2.0-only
/*
 * Google Zuma Common Audio Device Tree Source
 *
 * Copyright (c) 2022 Google, LLC
 *              https://www.google.com
 *
*/

#include "gs101-audio.dtsi"
