## Documentation/devicetree/bindings/pci/controller/dwc/pcie-exynos-rc.yaml
```yaml
# SPDX-License-Identifier: (GPL-2.0 OR BSD-2-Clause)
%YAML 1.2
---
$schema: http://devicetree.org/meta-schemas/core.yaml#

title: exynos_pcie_rc driver device tree bindings

maintainers:
  - Ting-Hsin Chen <tinghsin@google.com>

description: |
  The exynos_pcie_rc driver implements driver of Designware (Synopsis) based
  PCIe controller with Samsung provided PHY interface.

properties:
  de-emphasis-level:
    description: The setting for de-emphasis level, 1b'1 = -3.5 dB, 1b'0 = -6 dB
    type: int
    default: 0
```

## Kconfig
```kconfig
#
# HDCP driver configuration
#

config EXYNOS_HDCP2
	tristate "HDCP2 driver support"
	default m
	help
	  Enable HDCP2 support

if EXYNOS_HDCP2

config HDCP2_EMULATION_MODE
	bool "HDCP2 emulation mode support"
	default n
	help
	  Enable HDCP2 emulation mode support

config HDCP2_DP_ENABLE
         bool "HDCP2 DP protocol support"
         default y
         help
           Enable HDCP2 DP protocol support

config HDCP2_FUNC_TEST_MODE
         bool "HDCP2 DP Default Enabled"
         default n
         help
           Enable HDCP2 DP Function test mode.

config HDCP2_2_ERRATA_SUPPORT
         bool "HDCP2.2 ERRATA"
         default y
         help
           Enable HDCP2_2 errata support

endif
```

## Kconfig.ext.shusky
```kconfig
# SPDX-License-Identifier: GPL-2.0

source "$(KCONFIG_EXT_MODULES_PREFIX)private/google-modules/radio/samsung/s5300/Kconfig"

source "$(KCONFIG_EXT_MODULES_PREFIX)private/google-modules/touch/common/Kconfig"

source "$(KCONFIG_EXT_MODULES_PREFIX)private/google-modules/touch/fts/ftm5/Kconfig"

source "$(KCONFIG_EXT_MODULES_PREFIX)private/google-modules/touch/sec/Kconfig"
```

## debug_all_defconfig
```kconfig
CONFIG_BLK_DEBUG_FS=y
CONFIG_BLK_DEV_NULL_BLK=y
CONFIG_BLK_DEV_NULL_BLK_FAULT_INJECTION=y
CONFIG_CHECKPOINT_RESTORE=y
CONFIG_DEBUG_ATOMIC_SLEEP=y
CONFIG_DEBUG_BUGVERBOSE=y
CONFIG_DEBUG_FS=y
CONFIG_DEBUG_INFO=y
CONFIG_DEBUG_INFO_REDUCED=y
CONFIG_DEBUG_KERNEL=y
CONFIG_DEBUG_LIST=y
CONFIG_DEBUG_LOCKING_API_SELFTESTS=y
CONFIG_DEBUG_LOCK_ALLOC=y
CONFIG_DEBUG_MUTEXES=y
CONFIG_DEBUG_OBJECTS=y
CONFIG_DEBUG_OBJECTS_FREE=y
CONFIG_DEBUG_OBJECTS_RCU_HEAD=y
CONFIG_DEBUG_OBJECTS_SELFTEST=y
CONFIG_DEBUG_OBJECTS_TIMERS=y
CONFIG_DEBUG_OBJECTS_WORK=y
CONFIG_DEBUG_PAGEALLOC=y
CONFIG_DEBUG_PAGEALLOC_ENABLE_DEFAULT=y
CONFIG_DEBUG_PAGE_REF=y
CONFIG_DEBUG_PER_CPU_MAPS=y
CONFIG_DEBUG_PREEMPT=y
CONFIG_DEBUG_RWSEMS=y
CONFIG_DEBUG_SG=y
CONFIG_DEBUG_SPINLOCK=y
CONFIG_DEBUG_STACK_USAGE=y
CONFIG_DETECT_HUNG_TASK=y
CONFIG_DMA_API_DEBUG=y
CONFIG_DMA_API_DEBUG_SG=y
CONFIG_DYNAMIC_DEBUG=y
CONFIG_FAULT_INJECTION=y
CONFIG_FTRACE=y
CONFIG_HARDENED_USERCOPY=y
CONFIG_KALLSYMS=y
CONFIG_MAGIC_SYSRQ=y
CONFIG_PCI_DEBUG=y
CONFIG_PM_DEBUG=y
CONFIG_PREEMPT=y
CONFIG_PROVE_LOCKING=y
CONFIG_PROVE_RCU=y
CONFIG_RUNTIME_TESTING_MENU=y
CONFIG_SCHED_DEBUG=y
CONFIG_SCSI_UFS_FAULT_INJECTION=y
CONFIG_SOFTLOCKUP_DETECTOR=y
CONFIG_TOUCHSCREEN_SUR40=y
CONFIG_TRACING_SUPPORT=y
CONFIG_UBSAN=y
CONFIG_UBSAN_SANITIZE_ALL=y
CONFIG_WQ_WATCHDOG=y
# CONFIG_RANDOMIZE_BASE is not set
# CONFIG_RANDOMIZE_KSTACK_OFFSET_DEFAULT is not set
```

## drivers/input/keyboard/Kconfig
```kconfig
# SPDX-License-Identifier: GPL-2.0-only
#

if INPUT_KEYBOARD
config KEYBOARD_S2MPG14
       tristate "Samsung Electronics S2MPG14 Powerkey Controller"

endif # INPUT_KEYBOARD
```

## drivers/performance/lat_governors/Kconfig
```kconfig
# SPDX-License-Identifier: GPL-2.0-only

config GS_LATENCY_GOVERNOR
	tristate "Google Memory Latency Governors"
	depends on GS_PERF_MON
	default n
	help
	  A set of latency governors providing votes for the memory subsystem.
	  The governors only compute target frequencies for the DSU, BCI, and DDR
	  then supplies them to the devfreq for processing.

config GS_LATENCY_DEVFREQ
	tristate "Google Memory Latency Drivers"
	depends on GS_PERF_MON
	default n
	help
	  This adds the DEVFREQ drivers for the Google Latency Governors.
```

## drivers/soc/google/gsa/Kconfig
```kconfig
# SPDX-License-Identifier: GPL-2.0

config GSA
	tristate "GSA driver"
	default n

config GSA_PKVM
	tristate "Support pKVM"
	depends on GSA
	depends on PKVM_S2MPU_V9
	default n

config GSA_GSC
	tristate "GSC Proxy"
	depends on GSA
	default n
```

## drivers/thermal/Kconfig
```kconfig
# SPDX-License-Identifier: GPL-2.0-only
#
# Generic thermal drivers configuration
#

if THERMAL

menu "Samsung thermal drivers"
depends on (ARCH_EXYNOS || SOC_GOOGLE) || COMPILE_TEST
source "$(KCONFIG_EXT_PREFIX)drivers/thermal/samsung/Kconfig"
source "$(KCONFIG_EXT_PREFIX)drivers/thermal/google/Kconfig"
endmenu

endif
```

## drivers/usb/gadget/Kconfig
```kconfig
# SPDX-License-Identifier: GPL-2.0
#
# USB Gadget support on a system involves
#    (a) a peripheral controller, and
#    (b) the gadget driver using it.
#
# NOTE:  Gadget support ** DOES NOT ** depend on host-side CONFIG_USB !!
#
#  - Host systems (like PCs) need CONFIG_USB (with "A" jacks).
#  - Peripherals (like PDAs) need CONFIG_USB_GADGET (with "B" jacks).
#  - Some systems have both kinds of controllers.
#
# With help from a special transceiver and a "Mini-AB" jack, systems with
# both kinds of controller can also support "USB On-the-Go" (CONFIG_USB_OTG).
#

if USB_GADGET

config USB_F_DM
	tristate

config USB_F_ETR_MIU
	tristate

config USB_F_RNDIS_GS
	tristate

config USB_CONFIGFS_F_DM
	tristate "DM gadget"
	depends on USB_CONFIGFS
	select USB_F_DM
	select USB_U_SERIAL
	help
	  USB gadget DM(Diagnosis Monitor) support

config USB_CONFIGFS_F_ETR_MIU
	tristate "ETR_MIU"
	depends on USB_CONFIGFS
	select USB_F_ETR_MIU
	help
	  The ETR_MIU function enables sending trace data from Coresight ETR to USB
	  via ETR_MIU. The function has an interface with two alternate settings.
	  Alt0 setting is idle mode. Alt1 setting is data transfer mode. USB host
	  must set Alt1 before attempting to download trace data.

config USB_CONFIGFS_RNDIS_GS
	tristate "RNDIS"
	depends on USB_CONFIGFS
	depends on NET
	select USB_F_RNDIS_GS
	help
	  Microsoft Windows XP bundles the "Remote NDIS" (RNDIS) protocol,
	  and Microsoft provides redistributable binary RNDIS drivers for
	  older versions of Windows.

	  To make MS-Windows work with this, use Documentation/usb/linux.inf
	  as the "driver info file".  For versions of MS-Windows older than
	  XP, you'll need to download drivers from Microsoft's website; a URL
	  is given in comments found in that info file.

endif # USB_GADGET
```

## fst2/Kconfig
```kconfig
#
# STMicroelectronics TOUCH driver configuration
#

config TOUCHSCREEN_FST2
	tristate "STMicroelectronics multitouch touchscreen - FingerTipS (FTM5)"
	depends on I2C || SPI
	help
	  Say Y here to enable STMicroelectronics (FTM5) touchscreen support.
	  If unsure, say N.
	  To compile this driver as a module, choose M here: the module
	  will be called ftm5.
```

## google-modules/edgetpu/rio/drivers/edgetpu/Kconfig
```kconfig
menu "EdgeTPU devices"

config EDGETPU_FRAMEWORK
	tristate "EdgeTPU framework"
	depends on ARM64
	select DMA_SHARED_BUFFER
	select GENERIC_ALLOCATOR
	select IOMMU_API
	select SYNC_FILE
	help
	  This framework supports the Edge TPU Machine Learning accelerator
	  devices included in various Google SoCs.

config RIO
	tristate "Rio ML accelerator device driver"
	depends on EDGETPU_FRAMEWORK
	select PM
	help
	  This driver supports the Rio device.  Say Y if you want to include
	  this driver in the kernel.

	  To compile this driver as a module, choose M here.  The module
	  will be called "rio".

config EDGETPU_TELEMETRY_TRACE
	bool "Build EdgeTPU driver with firmware tracing support"
	depends on EDGETPU_FRAMEWORK
	default y
	help
	  Say Y to have the driver handle the tracing events sent from the
	  firmware. Enable this will increase the time for setup, suggest to
	  disable this in production mode to reduce the software overhead.

	  It's fine to have this enabled even the firmware doesn't send tracing
	  events.

endmenu
```

## google-modules/power/reset/Kconfig
```kconfig
# SPDX-License-Identifier: GPL-2.0

config POWER_RESET_EXYNOS
	tristate "Samsung Exynos power-off driver"
	depends on SOC_GS101 || SOC_GS201 || SOC_ZUMA
	help
	  Reboot support for Samsung Exynos boards.
```

## google-modules/soc/gs/Kconfig.ext
```kconfig
# SPDX-License-Identifier: GPL-2.0

source "$(KCONFIG_EXT_PREFIX)drivers/pci/controller/dwc/Kconfig"

source "$(KCONFIG_EXT_PREFIX)drivers/misc/Kconfig"

source "$(KCONFIG_EXT_PREFIX)drivers/clk/gs/Kconfig"

source "$(KCONFIG_EXT_PREFIX)drivers/soc/google/Kconfig"

source "$(KCONFIG_EXT_PREFIX)drivers/input/Kconfig"

source "$(KCONFIG_EXT_PREFIX)drivers/char/hw_random/Kconfig"

source "$(KCONFIG_EXT_PREFIX)drivers/tty/serial/Kconfig"

source "$(KCONFIG_EXT_PREFIX)drivers/ufs/Kconfig"

source "$(KCONFIG_EXT_PREFIX)drivers/i2c/busses/Kconfig"

source "$(KCONFIG_EXT_PREFIX)drivers/usb/Kconfig"

source "$(KCONFIG_EXT_PREFIX)drivers/rtc/Kconfig"

source "$(KCONFIG_EXT_PREFIX)drivers/dma/Kconfig"

source "$(KCONFIG_EXT_PREFIX)drivers/dma-buf/heaps/Kconfig"

source "$(KCONFIG_EXT_PREFIX)drivers/spi/Kconfig"

source "$(KCONFIG_EXT_PREFIX)drivers/spmi/Kconfig"

source "$(KCONFIG_EXT_PREFIX)drivers/pinctrl/Kconfig"

source "$(KCONFIG_EXT_PREFIX)drivers/power/Kconfig"

source "$(KCONFIG_EXT_PREFIX)drivers/thermal/Kconfig"

source "$(KCONFIG_EXT_PREFIX)drivers/watchdog/Kconfig"

source "$(KCONFIG_EXT_PREFIX)drivers/regulator/Kconfig"

source "$(KCONFIG_EXT_PREFIX)drivers/mfd/Kconfig"

source "$(KCONFIG_EXT_PREFIX)drivers/media/platform/Kconfig"

source "$(KCONFIG_EXT_PREFIX)drivers/video/Kconfig"

source "$(KCONFIG_EXT_PREFIX)drivers/clocksource/Kconfig"

source "$(KCONFIG_EXT_PREFIX)drivers/iommu/Kconfig"

source "$(KCONFIG_EXT_PREFIX)drivers/cpufreq/Kconfig"

source "$(KCONFIG_EXT_PREFIX)drivers/devfreq/google/Kconfig"

source "$(KCONFIG_EXT_PREFIX)drivers/performance/gs_perf_mon/Kconfig"

source "$(KCONFIG_EXT_PREFIX)drivers/performance/lat_governors/Kconfig"

source "$(KCONFIG_EXT_PREFIX)drivers/iio/Kconfig"

source "$(KCONFIG_EXT_PREFIX)drivers/phy/Kconfig"

source "$(KCONFIG_EXT_PREFIX)drivers/staging/android/Kconfig"

source "$(KCONFIG_EXT_PREFIX)drivers/bts/Kconfig"

source "$(KCONFIG_EXT_PREFIX)drivers/block/zram/Kconfig"

source "$(KCONFIG_EXT_PREFIX)Kconfig.ext_modules"
```

## google-modules/soc/gs/Kconfig.ext_modules
```kconfig
# SPDX-License-Identifier: GPL-2.0

source "$(KCONFIG_EXT_MODULES_PREFIX)private/google-modules/bms/misc/Kconfig"
source "$(KCONFIG_EXT_MODULES_PREFIX)private/google-modules/touch/common/Kconfig"
source "$(KCONFIG_EXT_MODULES_PREFIX)private/google-modules/touch/fts/ftm5/Kconfig"
source "$(KCONFIG_EXT_MODULES_PREFIX)private/google-modules/trusty/drivers/trusty/Kconfig"
source "$(KCONFIG_EXT_MODULES_PREFIX)private/google-modules/power/reset/Kconfig"
```

## google-modules/soc/gs/drivers/gpu/exynos/Kconfig
```kconfig
# SPDX-License-Identifier: GPL-2.0

menu "Exynos Graphic Devices"
source "$(KCONFIG_EXT_PREFIX)drivers/gpu/exynos/g2d/Kconfig"
endmenu
```

## google-modules/soc/gs/drivers/iio/Kconfig
```kconfig
# SPDX-License-Identifier: GPL-2.0-only
#
# Industrial I/O subsystem configuration
#

if IIO

source "$(KCONFIG_EXT_PREFIX)drivers/iio/power/Kconfig"

endif # IIO
```

## google-modules/soc/gs/drivers/input/misc/Kconfig
```kconfig
# SPDX-License-Identifier: GPL-2.0-only
#
# Input misc drivers configuration
#

if INPUT_MISC

source "$(KCONFIG_EXT_PREFIX)drivers/input/misc/vl53l1/Kconfig"

endif
```

## google-modules/soc/gs/drivers/phy/Kconfig
```kconfig
# SPDX-License-Identifier: GPL-2.0-only
#
# PHY
#

source "$(KCONFIG_EXT_PREFIX)drivers/phy/samsung/Kconfig"
```

## google-modules/soc/gs/drivers/power/Kconfig
```kconfig
# SPDX-License-Identifier: GPL-2.0-only
source "$(KCONFIG_EXT_PREFIX)drivers/power/reset/Kconfig"
```

## google-modules/soc/gs/drivers/staging/android/Kconfig
```kconfig
# SPDX-License-Identifier: GPL-2.0

config DELAY_INIT
	tristate "Delay Init Module"
	help
	  This driver can be used to delay second stage init
```

## google-modules/soc/gs/drivers/ufs/Kconfig
```kconfig
# SPDX-License-Identifier: GPL-2.0-only

config SCSI_UFS_EXYNOS_GS
	tristate "EXYNOS UFS Host Controller Driver for GS SoCs"
	depends on SCSI_UFSHCD && SCSI_UFSHCD_PLATFORM
	help
	  This selects the GS UFS host controller driver which
	  run with GS SoCs.

	  If you have a controller with this interface, say Y or M here.

config SCSI_UFS_PIXEL_FIPS140
	tristate "Enable FIPS 140 CMVP Module"
	depends on m && SCSI_UFS_EXYNOS_GS && SCSI_UFS_CRYPTO && \
		   !LTO_NONE && !FUNCTION_TRACER
	help
	  Build a module capable of executing FIPS140-3 compliant self tests of
	  the UFS crypto engine. The module is used to execute power on self
	  test for cases where the hardware component does not support
	  the functionality natively.
```

## google-modules/soc/gs/drivers/usb/host/Kconfig
```kconfig
# SPDX-License-Identifier: GPL-2.0
#
# USB Host Controller Drivers
#

if USB_XHCI_HCD

config USB_XHCI_EXYNOS
	tristate "xHCI support for EXYNOS SoCs"
	help
	  Say 'Y' to enable the support for the xHCI host controller
	  found in Exynos SoCs.

endif # USB_XHCI_HCD
```

## google-modules/soc/gs/drivers/usb/typec/Kconfig
```kconfig
# SPDX-License-Identifier: GPL-2.0

if TYPEC

source "$(KCONFIG_EXT_PREFIX)drivers/usb/typec/tcpm/Kconfig"

endif # TYPEC
```

## google-modules/soc/gs/drivers/usb/typec/tcpm/Kconfig
```kconfig
# SPDX-License-Identifier: GPL-2.0

source "$(KCONFIG_EXT_PREFIX)drivers/usb/typec/tcpm/google/Kconfig"
```

## google-modules/soc/gs/drivers/video/Kconfig
```kconfig
# SPDX-License-Identifier: GPL-2.0-only
#
# Video configuration
#

if HAS_IOMEM

source "$(KCONFIG_EXT_PREFIX)drivers/gpu/exynos/Kconfig"

endif
```
