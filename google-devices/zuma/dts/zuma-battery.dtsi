// SPDX-License-Identifier: GPL-2.0-only
/*
 * Battery device tree entries specific to ripcurrent
 *
 * Copyright 2023 Google LLC
 *
 */
/ {
	fragment@battery {
		target-path = "/";
		__overlay__ {

			google_battery: google,battery {
				status = "okay";
				compatible = "google,battery";
				google,fg-psy-name = "maxfg";

				/* charge table */
				google,chg-temp-limits = <0 100 200 420 460 480 550>;
				google,chg-cv-limits = <4200000 4300000 4350000 4450000>;
				google,chg-cc-limits = <
					 50   30    0   0
					 70   30   30  30
					150  150  150  50
					100  100  100  50
					 50   50    0   0
					 30    0    0   0
				>;

				google,ttf-temp-idx= <2>;
				google,ttf-adapter = <1800>;
				google,ttf-soc-table =  <49 59 72 78 93 95  98 100>;
				google,ttf-elap-table = <45 52 56 67 78 91 104 120>;
				google,ttf-tier-table = <0 71 78>;

				/* IRDrop Compensation */
				google,fv-uv-resolution = <10000>;
				/* NOTE: high value for DC charging */
				google,fv-uv-margin-dpct = <1025>;
				/* tier switch */
				google,cv-range-accuracy = <20000>;
				google,cv-otv-margin = <12000>;
				google,cv-debounce-cnt = <3>;
				google,cv-tier-ov-cnt = <10>;
				google,cv-tier-switch-cnt = <3>;

				/* rest charging */
				google,chg-rest-rate = <15>;
				google,chg-rest-soc = <80>;
				/* TRICKLE-DEFEND threshold */
				google,bd-trickle-recharge-soc = <80>;
				/* Disable TRICKLE-DEFEND, b/259428308 */
				/* google,bd-trickle-enable; */
				/* Battery virtual sensor */
				google,batt-vs-tz-name = "batt_vs";

				/* record over temperature time */
				google,temp-record-thr = <300 350 400>;
				google,soc-record-thr = <90 90 95>;

				/* bhi */
				google,bhi-status-marginal = <79>;
				google,bhi-status-need-rep = <79>;
				google,bhi-cycle-grace = <100>;
				google,bhi-algo-ver = <3>;

				#thermal-sensor-cells = <0>;
				#cooling-cells = <2>;
				google,dc-irdrop;
				google,fv-dc-ratio = <30>;

				google,eeprom-pairing;
			};

			google_bms {
				nvmem = <&pack_bee>;
				nvmem-names = "bms-pack-eeprom";
				/* pack eeprom is available only with P20+ batteries */
				google,bee-name = "bms-pack-eeprom";
			};

		};
	};
};
