// SPDX-License-Identifier: GPL-2.0-only
/*
 * Google device tree source
 *
 * Copyright 2022 Google Inc.
 *
 */
#include "zuma-common-touch.dtsi"

&spitouch {
	status = "ok";
	compatible = "st,fts";
	spi-max-frequency = <10000000>;

	pinctrl-names = "pmx_ts_active", "pmx_ts_suspend";

	st,irq-gpio = <&gpn0 0 0>;
	st,reset-gpio = <&gpp21 2 0>;
	st,device_name = "fts";
	st,firmware_names = "ftm5_fw.ftb";
	st,limits_names = "stm_fts_production_limits.csv";

	controller-data {
		samsung,spi-feedback-delay = <0>;
		samsung,spi-chip-select-mode = <0>;
		cs-clock-delay = <2>;
	};
};
