// SPDX-License-Identifier: GPL-2.0-only
/*
 * Battery device tree entries specific to panther
 *
 * Copyright 2022 Google,LLC
 *
 */

&pca9468_dc {
	pca9468,input-current-limit = <2700000>; /* 5.4A max */
};

&google_charger {
   google,thermal-stats-lvl-map = <0 8 16 25>;
};

&google_cpm {
	google,wlc-dc-fcc-ua = <4037000>; /* 0.9C(4485mah) */

	// thermal budgets
	google,mdis-thermal-mitigation =
	<3402000 3260000 3128000 3064000 3000000 2941000 2883000 2825000 2768000
	 2710000 2653000 2490000 2360000 2220000 2108000 1995000 1990000 1794000
	 1705000 1606000 1534000 1472000 1411000 1360000 1333000 1305000>;
	// source ONLINE selection criteria
	google,mdis-out-sel-online = <1 2>;
	// PD+main-charger, WLC+main-charger
	google,mdis-out0-limits =
	<4000000 3860000 3720000 3580000 3440000 3300000 3160000 3020000 2880000
	 2740000 2600000 2460000 2320000 2180000 2040000 1900000 1760000 1620000
	 1480000 1340000 1200000 1060000 920000  780000  640000  500000
	 1100000 1100000 1100000 1100000 1100000 1100000 1100000 1100000 1100000
	 1100000 1100000 1100000 1050000 1000000 950000  900000  850000  800000
	 750000  700000  650000  600000  550000  500000  450000  400000>;
	// PPS_CP+pca94xx-mains, // WLC_CP+pca94xx-mains
	google,mdis-out1-limits =
	<5400000 5224000 5048000 4872000 4696000 4520000 4344000 4168000 3992000
	 3816000 3640000 3464000 3288000 3112000 2936000 2760000 2584000 2408000
	 2232000 2056000 1880000 1704000 1528000 1352000 1176000 1000000
	 4000000 3800000 3600000 3500000 3400000 3300000 3200000 3100000 3000000
	 2900000 2800000 2600000 2400000 2200000 2000000 1800000 1600000 1400000
	 1200000 1000000 900000  800000  700000  600000  500000  400000>;
};

/* TODO: thermal hal */
