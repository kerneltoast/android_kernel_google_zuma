// SPDX-License-Identifier: GPL-2.0-only
/*
 * Battery device tree entries specific to panther
 *
 * Copyright 2022 Google,LLC
 *
 */

&pca9468_dc {
	pca9468,input-current-limit = <3000000>; /* 6A max */
};

&google_charger {
   google,thermal-stats-lvl-map = <0 8 16 25>;
};

&google_cpm {
	google,wlc-dc-fcc-ua = <4950000>; /* 1C(4950mah) */

	// thermal budgets
	google,mdis-thermal-mitigation =
	<3710000 3571000 3443000 3297000 3162000 3040000 2918000 2810000 2703000
	 2598000 2493000 2330000 2200000 2080000 1968000 1865000 1770000 1684000
	 1595000 1506000 1444000 1382000 1351000 1320000 1273000 1225000>;
	// source ONLINE selection criteria
	google,mdis-out-sel-online = <1 2>;
	// PD+main-charger, WLC+main-charger
	google,mdis-out0-limits =
	<4000000 3860000 3720000 3580000 3440000 3300000 3160000 3020000 2880000
	 2740000 2600000 2460000 2320000 2180000 2040000 1900000 1760000 1620000
	 1480000 1340000 1200000 1060000 920000  780000  640000  500000
	 1100000 1100000 1100000 1100000 1100000 1100000 1100000 1100000 1100000
	 1100000 1100000 1100000 1050000 1000000 950000  900000  850000  800000
	 750000  700000  650000  600000  550000  500000  450000  400000>;
	// PPS_CP+pca94xx-mains, // WLC_CP+pca94xx-mains
	google,mdis-out1-limits =
	<6000000 5800000 5600000 5400000 5200000 5000000 4800000 4600000 4400000
	 4200000 4000000 3800000 3600000 3400000 3200000 3000000 2800000 2600000
	 2400000 2200000 2000000 1800000 1600000 1400000 1200000 1000000
	 4800000 4600000 4400000 4200000 4000000 3800000 3600000 3400000 3200000
	 3000000 2800000 2600000 2400000 2200000 2000000 1800000 1600000 1400000
	 1200000 1000000 900000  800000  700000  600000  500000  400000>;
};

&pca9468_dc {
	pca9468,iin-max-offset = <50>; /* 50mA */
};
/* TODO: thermal hal */

