// SPDX-License-Identifier: GPL-2.0-only
/*
 * Battery device tree entries
 *
 * Copyright 2022 Google LLC
 *
 */

maxim,config {

	/* ATL: 1_ATL_2937_2_011421_3.3V_RC2_V03.txt, 2021-11-18, b/205853069 */
	maxim,cos-a1-1k {
		maxim,batt-id-kohm = <1>;
		maxim,model-version = <7>;
		maxim,force-reset-model-data;
		maxim,fg-model = /bits/ 16 <
			0xa4c0 0xaa10 0xb710 0xb9a0 0xbba0 0xbc30 0xbd20 0xbeb0
			0xc030 0xc2e0 0xc560 0xc980 0xcbf0 0xcf10 0xd600 0xdc00
			0x02f0 0x0140 0x0a50 0x0df0 0x13a0 0x0d80 0x1af0 0x1300
			0x0d10 0x07a0 0x0810 0x07c0 0x0780 0x0690 0x0730 0x0730
			0x0200 0x0200 0x0200 0x0200 0x0200 0x0200 0x0200 0x0200
			0x0200 0x0200 0x0200 0x0200 0x0200 0x0200 0x0200 0x0200
		>;
		maxim,fg-params = /bits/ 16 <
			/* 0x0036 */	0xf060	/* IAvgEmpty */
			/* 0x002a */	0x0839	/* RelaxCFG */
			/* 0x0028 */	0x260e	/* LearnCFG */
			/* 0x001D */	0x4217	/* Config */
			/* 0x00BB */	0x0090	/* Config2 */
			/* 0x0013 */	0x5f00	/* FullSOCthr */
			/* 0x0035 */	0x09d6	/* FullCAPRep */
			/* 0x0018 */	0x09d6	/* DesignCap */
			/* 0x0046 */	0x3200	/* dPacc */
			/* 0x0045 */	0x0275	/* dQacc */
			/* 0x0023 */	0x09d6	/* FullCAPNom */
			/* 0x003A */	0xa561	/* V_empty */
			/* 0x0012 */	0x3100	/* QResidual00 */
			/* 0x0022 */	0x1580	/* QResidual10 */
			/* 0x0032 */	0x0800	/* QResidual20 */
			/* 0x0042 */	0x0780	/* QResidual30 */
			/* 0x0038 */	0x0860	/* RCOMP0 */
			/* 0x0039 */	0x0d02	/* TempCo */
			/* 0x001E */	0x0620	/* ICHGTerm */
			/* 0x002C */	0xED51	/* TGain */
			/* 0x002D */	0x1EBA	/* TOff */
			/* 0x00B9 */	0x0014	/* Curve */
			/* 0x002B */	0x3870	/* MiscCFG */
			/* 0x0004 */	0x1900	/* AtRate */
			/* 0x0049 */	0x2241	/* convgcfg */
			/* 0x0029 */	0xc623	/* FilterCFG */
			/* 0x003c */	0x2D00	/* TaskPeriod */
		>;
	};

	/* Placeholder for 1.5C battery model, b/256901351#comment17 with 5310mAh */
	maxim,cos-a1-10k {
		maxim,batt-id-kohm = <10>;
		maxim,model-version = <2>;
		maxim,force-reset-model-data;
		maxim,rc1-tempco = /bits/ 16 <0x131f>;
		maxim,rc2-tempco = /bits/ 16 <0x1502>;
		maxim,rc2-learncfg = /bits/ 16 <0x260e>;
		maxim,fg-model = /bits/ 16 <
			0x86b0 0xab80 0xb770 0xb960 0xbb60 0xbc50 0xbdf0 0xbee0
			0xc0c0 0xc2c0 0xc6c0 0xca40 0xcca0 0xd1c0 0xd650 0xdeb0
			0x0020 0x0200 0x1020 0x0a00 0x1c40 0x1030 0x1d20 0x0e00
			0x0fd0 0x05f0 0x06c0 0x0bd0 0x03f0 0x08f0 0x05d0 0x05d0
			0x0200 0x0200 0x0200 0x0200 0x0200 0x0200 0x0200 0x0200
			0x0200 0x0200 0x0200 0x0200 0x0200 0x0200 0x0200 0x0200
		>;
		maxim,fg-params = /bits/ 16 <
			/* 0x0036 */	0xf060	/* IAvgEmpty */
			/* 0x002a */	0x0839	/* RelaxCFG */
			/* 0x0028 */	0x260e	/* LearnCFG */
			/* 0x001D */	0x4217	/* Config */
			/* 0x00BB */	0x0090	/* Config2 */
			/* 0x0013 */	0x5f00	/* FullSOCthr */
			/* 0x0035 */	0x0A5F	/* FullCAPRep */
			/* 0x0018 */	0x0A5F	/* DesignCap */
			/* 0x0046 */	0x3200	/* dPacc */
			/* 0x0045 */	0x0297	/* dQacc */
			/* 0x0023 */	0x0A5F	/* FullCAPNom */
			/* 0x003A */	0xa561	/* V_empty */
			/* 0x0012 */	0x2000	/* QResidual00 */
			/* 0x0022 */	0x0d80	/* QResidual10 */
			/* 0x0032 */	0x0400	/* QResidual20 */
			/* 0x0042 */	0x0280	/* QResidual30 */
			/* 0x0038 */	0x0540	/* RCOMP0 */
			/* 0x0039 */	0x1502	/* TempCo */
			/* 0x001E */	0x06a0	/* ICHGTerm */
			/* 0x002C */	0xED51	/* TGain */
			/* 0x002D */	0x1EBA	/* TOff */
			/* 0x00B9 */	0x0014	/* Curve */
			/* 0x002B */	0x3870	/* MiscCFG */
			/* 0x0004 */	0x1900	/* AtRate */
			/* 0x0049 */	0x2241	/* convgcfg */
			/* 0x0029 */	0x0613	/* FilterCFG */
			/* 0x003c */	0x2D00	/* TaskPeriod */
		>;
	};
};
