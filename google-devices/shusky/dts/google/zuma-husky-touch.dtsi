// SPDX-License-Identifier: GPL-2.0-only
/*
 * Google device tree source
 *
 * Copyright 2022 Google Inc.
 *
 */

#include "../google-dts-base/zuma-fts-touch.dtsi"

&spi_20 {
	status = "okay";
	dma-mode;
	dmas = <&pdma1 18 &pdma1 19>;
	swap-mode = <1>;
};

&spitouch {
	spi-max-frequency = <10000000>;

	st,dchip_id = /bits/ 8 <0x36 0x40>;
	st,max-coords = <1343 2991>;
	st,panel_map = <&google_hk3 0>;

	st,sensor_inverted_x;
	st,sensor_inverted_y;

	/*goog,vrr-enabled;
	goog,vrr-display-rate = /bits/ 32 <60 120>;
	goog,vrr-touch-rate = /bits/ 32 <120 240>;
	goog,vrr-up-delay = <0>;
	goog,vrr-down-delay = <2>;*/

	goog,v4l2-enabled;
	goog,offload-enabled;
	goog,offload-caps-data-types = /bits/ 16 <0x1F>;
	goog,offload-caps-scan-types = /bits/ 16 <0xC0>;
	goog,offload-caps-context-channel-types = /bits/ 16 <0x0100>;
	goog,offload-caps-coord-filter;
	goog,touch_offload_id = /bits/ 8 <'h' 'k' '3' '0'>;
	goog,tbn-enabled;
	goog,display-resolution = /bits/ 16 <1344 2992>;
	goog,channel-num = /bits/ 16 <18 39>;
	goog,coord-filter-enabled;
};

&m_ldo25_reg {
	regulator-min-microvolt = <1800000>;
	regulator-max-microvolt = <1800000>;
	/delete-property/ regulator-always-on;
};

&m_ldo4_reg {
	regulator-min-microvolt = <3300000>;
	regulator-max-microvolt = <3300000>;
	/delete-property/ regulator-always-on;
};
